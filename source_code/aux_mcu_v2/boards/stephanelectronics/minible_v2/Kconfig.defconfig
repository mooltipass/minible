## source_code/aux_mcu_v2/boards/stephanelectronics/minible_v2/Kconfig.defconfig
```kconfig
# SPDX-License-Identifier: Apache-2.0

if BOARD_MINIBLE_V2

config BT_CTRL
	string "BT"
	default "BT"

endif # BOARD_MINIBLE_V2
```

## source_code/aux_mcu_v2/boards/stephanelectronics/minible_v2/board.yml
```yaml
board:
  name: minible_v2
  full_name: minible V2 aux mcu
  vendor: stephanelectronics
  socs:
    - name: nrf52833
```
