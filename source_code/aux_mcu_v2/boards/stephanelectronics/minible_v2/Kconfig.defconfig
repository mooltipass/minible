## source_code/aux_mcu_v2/boards/stephanelectronics/minible_v2/Kconfig.defconfig
```kconfig
# SPDX-License-Identifier: Apache-2.0

if BOARD_MINIBLE_V2

config BT_CTLR
	default BT

endif # BOARD_MINIBLE_V2
```

## source_code/aux_mcu_v2/boards/stephanelectronics/minible_v2/Kconfig.minible_v2
```kconfig
# SPDX-License-Identifier: Apache-2.0

config BOARD_MINIBLE_V2
	select SOC_NRF52833_QDAA
```

## source_code/aux_mcu_v2/boards/stephanelectronics/minible_v2/board.yml
```yaml
board:
  name: minible_v2
  vendor: stephanelectronics
  socs:
  - name: nrf52833
```
